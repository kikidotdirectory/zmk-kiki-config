## config/boards/shields/klotz/Kconfig.defconfig
```kconfig
if SHIELD_KLOTZ_LEFT

# Name must be less than 16 characters long!
config ZMK_KEYBOARD_NAME
    default "Klotz"

config ZMK_SPLIT_ROLE_CENTRAL
    default y

endif

if SHIELD_KLOTZ_LEFT || SHIELD_KLOTZ_RIGHT

config ZMK_SPLIT
    default y

endif
```
