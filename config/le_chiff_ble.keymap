#define CONFIG_WIRELESS
#define ZMK_BASE_LAYER(name, LT, RT, LM, RM, LB, RB, LH, RH)                   \
    ZMK_LAYER(                                                                 \
        name,                                                                  \
                 LT       RT                                                   \
                 LM       RM                                                   \
                 LB       RB                                                   \
                 LH &none RH                                                   \
    )

#include "zmk-helpers/key-labels/34.h"
#include "layouts/aptmak.keymap"

