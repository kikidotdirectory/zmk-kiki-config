#include <behaviors.dtsi>
#include <dt-bindings/zmk/keys.h>
#include <zmk-helpers/helper.h> // Requires zmk-helpers module.

#define ALPHA  0
#define BETA   1
#define NUMSYS 2
#define NUMNAV 3
#define SYM    4
#define FUN    5

#define ___ &trans
#define XXX &none

/* Global defaults */

#define QUICK_TAP_MS 350

&sk {
  release-after-ms = <900>;
  quick-release;
};

&sl { // Allow sticky mods to chord across sticky layers.
  ignore-modifiers;
};

&lt {
  flavor = "balanced";
  tapping-term-ms = <200>;
  quick-tap-ms = <QUICK_TAP_MS>;
};

/* Define combo helpers */

#define COMBO_TERM_FAST 22
#define COMBO_TERM_SLOW 45

#define COMBO_IDLE_FAST 120
#define COMBO_IDLE_SLOW 60

#define COMBOS_TOP_ROW(LAYER, LTPR, LTRM, LTMI, RTIM, RTMR, RTRP)                      \
	ZMK_COMBO(LAYER##_ltpr, LTPR, LM4 LM3, LAYER, COMBO_TERM_SLOW, COMBO_IDLE_FAST) \
	ZMK_COMBO(LAYER##_ltrm, LTRM, LM3 LM2, LAYER, COMBO_TERM_FAST, COMBO_IDLE_FAST) \
	ZMK_COMBO(LAYER##_ltmi, LTMI, LM2 LM1, LAYER, COMBO_TERM_FAST, COMBO_IDLE_FAST) \
	ZMK_COMBO(LAYER##_rtim, RTIM, RM1 RM2, LAYER, COMBO_TERM_FAST, COMBO_IDLE_FAST) \
	ZMK_COMBO(LAYER##_rtmr, RTMR, RM2 RM3, LAYER, COMBO_TERM_FAST, COMBO_IDLE_FAST) \
	ZMK_COMBO(LAYER##_rtrp, RTRP, RM3 RM4, LAYER, COMBO_TERM_SLOW, COMBO_IDLE_FAST)

#define COMBOS_BOT_ROW(LAYER, LBRM, LBMI, RBIM, RBMR) \
	COMBO(LAYER##_lbrm, LBRM, LB3 LB2, COMBO_TERM_FAST, COMBO_IDLE_FAST) \
	COMBO(LAYER##_lbmi, LBMI, LB2 LB1, COMBO_TERM_FAST, COMBO_IDLE_FAST) \
	COMBO(LAYER##_rbim, RBIM, RB1 RB2, COMBO_TERM_FAST, COMBO_IDLE_FAST) \
	COMBO(LAYER##_rbmr, RBMR, RB2 RB3, COMBO_TERM_FAST, COMBO_IDLE_FAST)

#define VERT_COMBOS(LAYER, LVR, LVM, LVI, RVI, RVM, RVR) \
	ZMK_COMBO(LAYER##_lvr, LVR, LM3 LB3, LAYER, COMBO_TERM_SLOW, COMBO_IDLE_SLOW) \
	ZMK_COMBO(LAYER##_lvm, LVM, LM2 LB2, LAYER, COMBO_TERM_SLOW, COMBO_IDLE_SLOW) \
	ZMK_COMBO(LAYER##_lvi, LVI, LM1 LB1, LAYER, COMBO_TERM_SLOW, COMBO_IDLE_SLOW) \
	ZMK_COMBO(LAYER##_rvr, RVR, RM3 RB3, LAYER, COMBO_TERM_SLOW, COMBO_IDLE_SLOW) \
	ZMK_COMBO(LAYER##_rvm, RVM, RM2 RB2, LAYER, COMBO_TERM_SLOW, COMBO_IDLE_SLOW) \
	ZMK_COMBO(LAYER##_rvi, RVI, RM1 RB1, LAYER, COMBO_TERM_SLOW, COMBO_IDLE_SLOW) \

/* Homerow mods */
#define KEYS_L LM1 LM2 LM3 LM4 LB1 LB2 LB3
#define KEYS_R RM1 RM2 RM3 RM4 RB1 RB2 RB3
#define THUMBS LH1 LH0 RH0 RH1

#define MAKE_HRM(NAME, HOLD, TAP, TRIGGER_POS)                                 \
  ZMK_HOLD_TAP(NAME, bindings = <HOLD>, <TAP>; flavor = "balanced";            \
               tapping-term-ms = <230>; quick-tap-ms = <QUICK_TAP_MS>;         \
               require-prior-idle-ms = <150>; hold-trigger-on-release;         \
               hold-trigger-key-positions = <TRIGGER_POS>;)

MAKE_HRM(hl, &kp, &kp, KEYS_R THUMBS) // Left-hand HRMs.
MAKE_HRM(hr, &kp, &kp, KEYS_L THUMBS) // Right-hand HRMS.

#define LH(k1, k2, k3, k4) &hl LGUI k1  &hl LALT k2  &hl LCTL k3  &hl LSHFT k4
#define RH(k1, k2, k3, k4) &hr RSHFT k1  &hr RCTL k2  &hr LALT k3  &hr RGUI k4

/* Custom behavior */

// Alt+Tab swapper, requires tri-state module.
ZMK_TRI_STATE(winswapper, bindings = <&kt LGUI>, <&kp TAB>, <&kt LGUI>;
              ignored-key-positions = <LM1 LM2 LM3 LM4>;)

ZMK_TRI_STATE(tabswapper, bindings = <&kt LCTL>, <&kp TAB>, <&kt LCTL>;
              ignored-key-positions = <LM1 LM2 LM3 LM4>;)

// Define mod-morph with a *single* mod trigger for less repetition.
#define SIMPLE_MORPH(NAME, MOD, BINDING1, BINDING2)                            \
  ZMK_MOD_MORPH(NAME, mods = <(MOD_L##MOD | MOD_R##MOD)>;                      \
                bindings = <BINDING1>, <BINDING2>;)

// Tap: comma | Shift + tap: semicolon
SIMPLE_MORPH(comma_morph, SFT, &kp COMMA, &kp SEMICOLON)
// Tap: period | Shift + tap: colon
SIMPLE_MORPH(dot_morph, SFT, &kp DOT, &kp COLON)

// Tap: Space | Alt + tap: period | Alt + Shift + tap: colon
//            | Ctl + tap: comma  | Ctl + Shift + tap: semicolon
SIMPLE_MORPH(spc_comma, CTL, &lt NUMNAV SPACE, &comma_morph)
SIMPLE_MORPH(spc_punc, ALT, &spc_comma, &dot_morph)

SIMPLE_MORPH(enter_tab, SFT, &kp ENTER, &kp TAB)
SIMPLE_MORPH(bspc_del, SFT, &kp BSPC, &kp DEL)

// Tap: slash | Shift + tap: asterisk
SIMPLE_MORPH(slash_star, SFT, &kp SLASH, &kp ASTERISK)

// Tap: parentheses | Shift + tap: angle bracket
SIMPLE_MORPH(lpar_morph, SFT, &kp LPAR, &kp LT)
SIMPLE_MORPH(rpar_morph, SFT, &kp RPAR, &kp GT)

#define BIGRAM(NAME, K1, K2) ZMK_MACRO(NAME, bindings = <&kp K1 &kp K2>;)

BIGRAM(rl, R, L)  BIGRAM(lr, L, R)
BIGRAM(dt, D, T)  BIGRAM(td, T, D)
BIGRAM(sy, S, Y)  BIGRAM(ys, Y, S)
BIGRAM(hm, H, M)  BIGRAM(mh, M, H)
BIGRAM(oa, O, A)  BIGRAM(ao, A, O)
BIGRAM(ui, U, I)  BIGRAM(iu, I, U)

/* Other small helpers */

MAKE_HRM(r_dot, &kp, &dot_morph, KEYS_L THUMBS)
// HACK: the HRM helper requires the second argument to be a &kp so this is a... workaround.


/* Combos */

/* Diagonal combos */
#define DIAG_BRACKET_PAIR(L_NAME, R_NAME, L_KEY, R_KEY, L_POS, R_POS, LAYER) \
    ZMK_COMBO(L_NAME, &kp L_KEY, L_POS, LAYER, COMBO_TERM_SLOW, COMBO_IDLE_FAST) \
    ZMK_COMBO(R_NAME, &kp R_KEY, R_POS, LAYER, COMBO_TERM_SLOW, COMBO_IDLE_FAST)


ZMK_COMBO(lpar,         &kp LPAR,              LM3     LB1,      ALPHA      NUMNAV NUMSYS SYM, COMBO_TERM_SLOW, COMBO_IDLE_SLOW)
ZMK_COMBO(lbkt,         &kp LBKT,              LB3     LM1,      ALPHA      NUMNAV NUMSYS SYM, COMBO_TERM_SLOW, COMBO_IDLE_SLOW)
ZMK_COMBO(rpar,         &kp RPAR,              RM3     RB1,      ALPHA      NUMNAV NUMSYS SYM, COMBO_TERM_SLOW, COMBO_IDLE_SLOW)
ZMK_COMBO(rbkt,         &kp RBKT,              RB3     RM1,      ALPHA      NUMNAV NUMSYS SYM, COMBO_TERM_SLOW, COMBO_IDLE_SLOW)
ZMK_COMBO(lt,           &kp LT,                LM3     LB1,            BETA                  , COMBO_TERM_SLOW, COMBO_IDLE_SLOW)
ZMK_COMBO(lbrc,         &kp LBRC,              LB3     LM1,            BETA                  , COMBO_TERM_SLOW, COMBO_IDLE_SLOW)
ZMK_COMBO(gt,           &kp GT,                RM3     RB1,            BETA                  , COMBO_TERM_SLOW, COMBO_IDLE_SLOW)
ZMK_COMBO(rbrc,         &kp RBRC,              RB3     RM1,            BETA                  , COMBO_TERM_SLOW, COMBO_IDLE_SLOW)

/* Middle horizontal combos */
ZMK_COMBO(tab,          &hl LC(LALT) TAB,          LM2 LM1,      ALPHA BETA        NUMSYS SYM, COMBO_TERM_FAST, COMBO_IDLE_FAST)
ZMK_COMBO(esc,          &hl LS(LALT) ESC,      LM3     LM1,      ALPHA BETA        NUMSYS SYM, COMBO_TERM_SLOW, COMBO_IDLE_FAST)
ZMK_COMBO(sqt,          &hl LC(LALT) SQT,      LM3 LM2    ,      ALPHA BETA               SYM, COMBO_TERM_FAST, COMBO_IDLE_FAST)
ZMK_COMBO(winswap,      &winswapper,               LM2 LM1,                 NUMNAV           , COMBO_TERM_FAST, COMBO_IDLE_SLOW)
ZMK_COMBO(tabswap,      &tabswapper,           LM3 LM2    ,                 NUMNAV           , COMBO_TERM_FAST, COMBO_IDLE_SLOW)
ZMK_COMBO(s_tab,        &mt LSHIFT LS(TAB),    LM3     LM1,                 NUMNAV           , COMBO_TERM_FAST, COMBO_IDLE_SLOW)

ZMK_COMBO(bsp,          &hr RS(RCTL) BSPC,     RM1 RM2    ,      ALPHA BETA NUMNAV NUMSYS SYM, COMBO_TERM_FAST, COMBO_IDLE_FAST)
ZMK_COMBO(minus,        &kp MINUS,                 RM2 RM3,      ALPHA BETA NUMNAV NUMSYS SYM, COMBO_TERM_FAST, COMBO_IDLE_FAST)
ZMK_COMBO(ret,          &hr RS(RALT) RET,      RM1     RM3,      ALPHA BETA NUMNAV NUMSYS SYM, COMBO_TERM_FAST, COMBO_IDLE_FAST)

/* Bottom Horizontal combos */
ZMK_COMBO(capsword,     &caps_word,                LB2 LB1,      ALPHA BETA NUMNAV        SYM, COMBO_TERM_SLOW, COMBO_IDLE_SLOW)
ZMK_COMBO(shift_l,      &sk LSHIFT,            LB3 LB2    ,      ALPHA BETA NUMNAV        SYM, COMBO_TERM_SLOW, COMBO_IDLE_SLOW)

ZMK_COMBO(fslash,       &kp SLASH,             RB1     RB3,      ALPHA BETA NUMNAV NUMSYS    , COMBO_TERM_SLOW, COMBO_IDLE_FAST)
ZMK_COMBO(shift_r,      &sk RSHIFT,                RB2 RB3,      ALPHA BETA NUMNAV NUMSYS SYM, COMBO_TERM_SLOW, COMBO_IDLE_SLOW)


/* Keymap layers */

ZMK_CONDITIONAL_LAYER(fun, NUMNAV SYM, FUN)
/* todo: could use this for different types of sym access by setting it to a mod morph or leader key */
ZMK_COMBO(fun,   &sl FUN,          LH0 RH0,          ALPHA BETA,                   COMBO_TERM_SLOW, COMBO_IDLE_FAST)

ZMK_BASE_LAYER(alpha,
//╭─────────────┬─────────────┬─────────────┬─────────────╮   ╭─────────────┬─────────────┬─────────────┬─────────────╮
LH(     N       ,     R       ,     T       ,     S      ), RH(     H       ,     A       ,     I       ,     E      ),
//╰─────────────┼─────────────┼─────────────┼─────────────┤   ├─────────────┼─────────────┼─────────────┼─────────────╯
                  &kp L         &kp D         &kp Y       ,     &kp M         &kp O         &kp U       ,
//              ╰─────────────┼─────────────┼─────────────┤   ├─────────────┼─────────────┼─────────────╯
                                &tog NUMSYS &lt NUMNAV SPACE,   &sl BETA      &sl SYM
//                            ╰─────────────┴─────────────╯   ╰─────────────┴─────────────╯
)

VERT_COMBOS(ALPHA, &rl, &dt, &sy, &hm, &oa, &ui)

ZMK_BASE_LAYER(beta,
//╭─────────────┬─────────────┬─────────────┬─────────────╮   ╭─────────────┬─────────────┬─────────────┬─────────────╮
LH(     P       ,     W       ,     B       ,     C      ),     &hr RSHIFT F  &hr RCTL Z   &r_dot RALT DOT &hr RGUI J ,
//╰─────────────┼─────────────┼─────────────┼─────────────┤   ├─────────────┼─────────────┼─────────────┼─────────────╯
                  &kp X         &kp V         &kp G       ,     &kp K         &kp Q         &comma_morph,
//              ╰─────────────┼─────────────┼─────────────┤   ├─────────────┼─────────────┼─────────────╯
                                ___           ___         ,     &kp 0         ___
//                            ╰─────────────┴─────────────╯   ╰─────────────┴─────────────╯
)

VERT_COMBOS(BETA, &lr, &td, &ys, &mh, &ao, &iu)

/* number-input layer */
ZMK_BASE_LAYER(numsys,
//╭─────────────┬─────────────┬─────────────┬─────────────╮   ╭─────────────┬─────────────┬─────────────┬─────────────╮
    &hl LSHFT N0  &hl LALT N1   &hl LCTL N2   &kp N3      ,     &sk RSHIFT    &sk RCTL      &sk RALT      &sk RGUI    ,
//╰─────────────┼─────────────┼─────────────┼─────────────┤   ├─────────────┼─────────────┼─────────────┼─────────────╯
                  &kp N4        &kp N5        &kp N6      ,     ___           ___           ___         ,
//              ╰─────────────┼─────────────┼─────────────┤   ├─────────────┼─────────────┼─────────────╯
                                ___           &spc_punc   ,     ___           ___
//                            ╰─────────────┴─────────────╯   ╰─────────────┴─────────────╯
)

VERT_COMBOS(NUMSYS, &kp N7, &kp N8, &kp N9, &none, &none, &none)
ZMK_COMBO(n_bsp,        &bspc_del,             LM3 LM2    ,                        NUMSYS     , COMBO_TERM_SLOW, COMBO_IDLE_FAST)
ZMK_COMBO(n_tab,        &enter_tab,            LM2 LM1    ,                        NUMSYS     , COMBO_TERM_SLOW, COMBO_IDLE_FAST)
ZMK_COMBO(n_esc,        &kp ESC,               LM3     LM1,                        NUMSYS     , COMBO_TERM_SLOW, COMBO_IDLE_FAST)
ZMK_COMBO(n_equal,      &kp EQUAL,             LB3     LB1,                        NUMSYS     , COMBO_TERM_FAST, COMBO_IDLE_SLOW)
ZMK_COMBO(n_comma,      &slash_star,           LB3 LB2    ,                        NUMSYS     , COMBO_TERM_FAST, COMBO_IDLE_SLOW)
ZMK_COMBO(n_minus,      &kp MINUS,                 LB2 LB1,                        NUMSYS     , COMBO_TERM_FAST, COMBO_IDLE_SLOW)

ZMK_BASE_LAYER(numnav,
//╭─────────────┬─────────────┬─────────────┬─────────────╮   ╭─────────────┬─────────────┬─────────────┬─────────────╮
LH(     LEFT    ,     DOWN    ,     UP      ,     RIGHT  ), RH(     N1      ,     N2      ,     N3      ,     N0     ),
//╰─────────────┼─────────────┼─────────────┼─────────────┤   ├─────────────┼─────────────┼─────────────┼─────────────╯
                  &kp PGDN      &kp PGUP      ___         ,     &kp N4        &kp N5        &kp N6      ,
//              ╰─────────────┼─────────────┼─────────────┤   ├─────────────┼─────────────┼─────────────╯
                                ___           ___         ,     &dot_morph    ___
//                            ╰─────────────┴─────────────╯   ╰─────────────┴─────────────╯
)

VERT_COMBOS(NUMNAV, &kp LG(C), &kp LG(X), &kp LG(V), &kp N7, &kp N8, &kp N9)

ZMK_BASE_LAYER(symbols,
//╭─────────────┬─────────────┬─────────────┬─────────────╮   ╭─────────────┬─────────────┬─────────────┬─────────────╮
LH(    EXCL     ,     AT      ,     HASH    ,     DOLLAR ), RH(   AMPERSAND ,     ASTERISK,     PERCENT ,     CARET  ),
//╰─────────────┼─────────────┼─────────────┼─────────────┤   ├─────────────┼─────────────┼─────────────┼─────────────╯
                  &kp GRAVE     &kp TILDE     &kp UNDERSCORE,   &kp BACKSLASH &kp PIPE      &kp EQUAL   ,
//              ╰─────────────┼─────────────┼─────────────┤   ├─────────────┼─────────────┼─────────────╯
                                &kp TILDE     &kp 0       ,     &kp 0         &kp 0 
//                            ╰─────────────┴─────────────╯   ╰─────────────┴─────────────╯
)

VERT_COMBOS(SYM, &kp LPAR, &kp LBKT, &kp LBRC, &kp RBRC, &kp RBKT, &kp RPAR)

ZMK_BASE_LAYER(function,
//╭─────────────┬─────────────┬─────────────┬─────────────╮   ╭─────────────┬─────────────┬─────────────┬─────────────╮
   &bootloader    &kp F12       &kp F11       &kp F10     ,     &kp F4        &kp F5        &kp F6        &none       ,
//╰─────────────┼─────────────┼─────────────┼─────────────┤   ├─────────────┼─────────────┼─────────────┼─────────────╯
                  &kp F9        &kp F8        &kp F7      ,     &kp F1        &kp F2        &kp F3      ,
//              ╰─────────────┼─────────────┼─────────────┤   ├─────────────┼─────────────┼─────────────╯
                                &trans        &trans      ,     &trans        &trans
//                            ╰─────────────┴─────────────╯   ╰─────────────┴─────────────╯
)
