#include <behaviors.dtsi>
#include <behaviors/num_word.dtsi> // Requires zmk-auto-layer module.
#include <behaviors/unicode.dtsi> // Requires zmk-unicode module.
#include <zmk-helpers/helper.h> // Requires zmk-helpers module.
#include <dt-bindings/zmk/keys.h>

#ifdef CONFIG_WIRELESS
  #include <dt-bindings/zmk/bt.h>
  #include <dt-bindings/zmk/outputs.h>
  #define _BT_SEL_KEYS_                                                        \
      &bt BT_SEL 0 &bt BT_SEL 1 &bt BT_SEL 2 &bt BT_SEL 3 &bt BT_CLR
#else
  #define _BT_SEL_KEYS_ &trans &trans &trans &trans &trans
#endif

#define DEF 0
#define NAV 1
#define SYM 2
#define FUN 3

#define XXX &none
#define ___ &trans

/* Global defaults */

#define QUICK_TAP_MS 350

&sk {
  release-after-ms = <900>;
  quick-release;
};

&sl { // Allow sticky mods to chord across sticky layers.
  ignore-modifiers;
};

&lt {
  flavor = "balanced";
  tapping-term-ms = <200>;
  quick-tap-ms = <QUICK_TAP_MS>;
};

/* Homerow mods */
#define KEYS_L LT0 LT1 LT2 LT3 LM0 LM1 LM2 LM3 LM4 LB1 LB2 LB3 LB4
#define KEYS_R RT0 RT1 RT2 RT3 RM0 RM1 RM2 RM3 RM4 RB1 RB2 RB3 RB4
#define THUMBS LH1 LH0 RH0 RH1

#define MAKE_HRM(NAME, HOLD, TAP, TRIGGER_POS)                                 \
  ZMK_HOLD_TAP(NAME, bindings = <HOLD>, <TAP>; flavor = "balanced";            \
               tapping-term-ms = <250>; quick-tap-ms = <QUICK_TAP_MS>;         \
               require-prior-idle-ms = <150>; hold-trigger-on-release;         \
               hold-trigger-key-positions = <TRIGGER_POS>;)


MAKE_HRM(hl, &kp, &kp, KEYS_R THUMBS) // Left-hand HRMs.
MAKE_HRM(hr, &kp, &kp, KEYS_L THUMBS) // Right-hand HRMS.

#define LH(k1, k2, k3, k4) &hl LGUI k1  &hl LALT k2  &hl LCTL k3  &hl LSHFT k4
#define RH(k1, k2, k3, k4) &hr RSHFT k1  &hr RCTL k2  &hr LALT k3  &hr RGUI k4

// Hack: Make HRM combos tap-only (cf, ZMK issue #544).
#define ZMK_COMBO_8(NAME, TAP, POS, LAYERS, COMBO_MS, IDLE_MS, HOLD, SIDE)     \
  MAKE_HRM(hm_combo_##NAME, &kp, TAP, SIDE THUMBS)                             \
  ZMK_COMBO_6(NAME, &hm_combo_##NAME HOLD 0, POS, LAYERS, COMBO_MS, IDLE_MS)

/* Combos, leader key sequences, mouse emulation */

#include "aptmak-combos.dtsi" // Must be sourced after HRM-combo hack.


/* Custom behaviors */
ZMK_CONDITIONAL_LAYER(function, SYM  NAV, FUN)

// Alt+Tab swapper, requires tri-state module.
ZMK_TRI_STATE(swapper, bindings = <&kt LGUI>, <&kp TAB>, <&kt LGUI>;
              ignored-key-positions = <LT3 LM1 LM2 LM3 LM4>;)

ZMK_TRI_STATE(tabswapper, bindings = <&kt LCTL>, <&kp TAB>, <&kt LCTL>;
              ignored-key-positions = <LT3 LM1 LM2 LM3 LM4>;)


// Define mod-morph with a *single* mod trigger for less repetition.
#define SIMPLE_MORPH(NAME, MOD, BINDING1, BINDING2)                            \
  ZMK_MOD_MORPH(NAME, mods = <(MOD_L##MOD | MOD_R##MOD)>;                      \
                bindings = <BINDING1>, <BINDING2>;)

// Tap: comma | Shift + tap: semicolon
SIMPLE_MORPH(comma_morph, SFT, &kp COMMA, &kp SEMICOLON)
// Tap: period | Shift + tap: colon
SIMPLE_MORPH(dot_morph, SFT, &kp DOT, &kp COLON)

// Tap: parentheses | Shift + tap: angle bracket
SIMPLE_MORPH(lpar_morph, SFT, &kp LPAR, &kp LT)
SIMPLE_MORPH(rpar_morph, SFT, &kp RPAR, &kp GT)

// Tap: backspace | Shift + tap: delete
SIMPLE_MORPH(bksp_del, SFT, &kp BACKSPACE, &kp DELETE)

SIMPLE_MORPH(smart_shift, SFT, &sk LSHIFT, &caps_word)

/* Macros */
ZMK_MACRO(qu,
  bindings = <&kp Q &kp U>;
)

ZMK_MACRO(wq,
  bindings = <&kp W &kp Q>;
)

/* Keymap */

ZMK_CONDITIONAL_LAYER(fun, NAV SYM, FUN) // NAV + SYM -> FUN

#ifndef ZMK_BASE_LAYER
  #define ZMK_BASE_LAYER(name, LT, RT, LM, RM, LB, RB, LH, RH)                 \
      ZMK_LAYER(name, LT RT LM RM LB RB LH RH)
#endif

ZMK_BASE_LAYER(base,
//╭─────────────┬─────────────┬─────────────┬─────────────┬─────────────╮   ╭─────────────┬─────────────┬─────────────┬─────────────┬─────────────╮
		XXX          &kp W         &kp F         &kp P          &kp B       ,     &kp J         &kp L         &kp U         &kp Y          XXX        ,
//├─────────────┼─────────────┼─────────────┼─────────────┼─────────────┤   ├─────────────┼─────────────┼─────────────┼─────────────┼─────────────┤
LH(     R       ,     S       ,     T       ,     H       ) &kp K       ,     &kp X     RH(     N       ,     A       ,     I       ,     O      ),
//├─────────────┼─────────────┼─────────────┼─────────────┼─────────────┤   ├─────────────┼─────────────┼─────────────┼─────────────┼─────────────┤
		XXX           &kp C         &kp G         &kp D         XXX         ,     XXX           &kp M         &comma_morph  &dot_morph    &kp X       ,
//╰─────────────┼─────────────┼─────────────┼─────────────┼─────────────┤   ├─────────────┼─────────────┼─────────────┼─────────────┼─────────────╯
																							XXX          &lt NAV SPACE,     &lt SYM  E    XXX
//                                          ╰─────────────┴─────────────╯   ╰─────────────┴─────────────╯
)


ZMK_BASE_LAYER(nav,
//╭─────────────┬─────────────┬─────────────┬─────────────┬─────────────╮   ╭─────────────┬─────────────┬─────────────┬─────────────┬─────────────╮
&bootloader &mt LSHIFT LS(TAB)   &tabswapper   &swapper      ___        ,     ___           ___           ___           ___           XXX         ,
//├─────────────┼─────────────┼─────────────┼─────────────┼─────────────┤   ├─────────────┼─────────────┼─────────────┼─────────────┼─────────────┤
LH(     LEFT    ,     DOWN    ,     UP      ,     RIGHT   )  ___        ,     ___       RH(     N1      ,     N2      ,     N3      ,     N0     ),
//├─────────────┼─────────────┼─────────────┼─────────────┼─────────────┤   ├─────────────┼─────────────┼─────────────┼─────────────┼─────────────┤
    &kp HOME      &kp PGDN      &kp PGUP      &kp END       XXX         ,     XXX           &kp N4        &kp N5        &kp N6        XXX         ,
//╰─────────────┼─────────────┼─────────────┼─────────────┼─────────────┤   ├─────────────┼─────────────┼─────────────┼─────────────┼─────────────╯
                                              ___           ___         ,     &kp DOT       ___
//                                          ╰─────────────┴─────────────╯   ╰─────────────┴─────────────╯
)

VERT_COMBOS(NAV, &kp LG(C), &kp LG(X), &kp LG(V), &kp N7, &kp N8, &kp N9)

ZMK_BASE_LAYER(sym,
//╭─────────────┬─────────────┬─────────────┬─────────────┬─────────────╮   ╭─────────────┬─────────────┬─────────────┬─────────────┬─────────────╮
    XXX           &kp GRAVE     &kp LBKT      &lpar_morph   XXX         ,     XXX           &rpar_morph   &kp RBKT      &kp BSLH      XXX         ,
//├─────────────┼─────────────┼─────────────┼─────────────┼─────────────┤   ├─────────────┼─────────────┼─────────────┼─────────────┼─────────────┤
   &kp EXCL       &kp AT        &kp HASH      &kp DOLLAR    XXX         ,     XXX           &kp AMPERSAND &kp ASTERISK  &kp PERCENT   &kp CARET   ,
//├─────────────┼─────────────┼─────────────┼─────────────┼─────────────┤   ├─────────────┼─────────────┼─────────────┼─────────────┼─────────────┤
    XXX           &kp GRAVE     &kp DQT       &kp UNDERSCORE XXX        ,     XXX           &kp BACKSLASH &kp PIPE      &kp EQUAL     XXX         ,
//╰─────────────┼─────────────┼─────────────┼─────────────┼─────────────┤   ├─────────────┼─────────────┼─────────────┼─────────────┼─────────────╯
                                              ___           ___         ,     ___           ___
//                                          ╰─────────────┴─────────────╯   ╰─────────────┴─────────────╯
)
VERT_COMBOS(SYM, &kp LPAR, &kp LBKT, &kp LBRC, &kp RBRC, &kp RBKT, &kp RPAR)

ZMK_BASE_LAYER(fun,
//╭─────────────┬─────────────┬─────────────┬─────────────┬─────────────╮   ╭─────────────┬─────────────┬─────────────┬─────────────┬─────────────╮
	  XXX           &kp F1        &kp F2        &kp F3        &kp F10     ,                                _BT_SEL_KEYS_                            ,
//├─────────────┼─────────────┼─────────────┼─────────────┼─────────────┤   ├─────────────┼─────────────┼─────────────┼─────────────┼─────────────┤
	  &kp F12       &kp F4        &kp F5        &kp F6        &kp F11     ,     ___           &kp C_PREV    &kp C_VOL_DN  &kp C_VOL_UP  &kp C_NEXT  ,
//├─────────────┼─────────────┼─────────────┼─────────────┼─────────────┤   ├─────────────┼─────────────┼─────────────┼─────────────┼─────────────┤
	  &bootloader   &kp F7        &kp F8        &kp F9        XXX         ,     XXX           &kp C_PP      &kp C_BRI_UP  &kp C_BRI_DN  &bootloader ,
//╰─────────────┼─────────────┼─────────────┼─────────────┼─────────────┤   ├─────────────┼─────────────┼─────────────┼─────────────┼─────────────╯
																							___           ___         ,     ___           ___
//                                          ╰─────────────┴─────────────╯   ╰─────────────┴─────────────╯
)
