#include <behaviors.dtsi>
#include <dt-bindings/zmk/keys.h>
#include <zmk-helpers/helper.h> // Requires zmk-helpers module.

#define APT 0
#define NUM 1
#define NAV 2
#define SYM 3
#define FUN 4

/* Global defaults */

#define QUICK_TAP_MS 175

&sk {
  release-after-ms = <900>;
  quick-release;
};

&sl { // Allow sticky mods to chord across sticky layers.
  ignore-modifiers;
};

&lt {
  flavor = "balanced";
  tapping-term-ms = <200>;
  quick-tap-ms = <QUICK_TAP_MS>;
};

#define COMBO(NAME, BINDINGS, KEYPOS) \
combo_##NAME { \
    timeout-ms = <20>; \
    bindings = <BINDINGS>; \
    key-positions = <KEYPOS>; \
};
#define SLOWCOMBO(NAME, BINDINGS, KEYPOS) \
combo_##NAME { \
    timeout-ms = <40>; \
    bindings = <BINDINGS>; \
    key-positions = <KEYPOS>; \
};
#define TCOMBO(NAME, BINDINGS, KEYPOS, TIMEOUT) \
combo_##NAME { \
    timeout-ms = <TIMEOUT>; \
    bindings = <BINDINGS>; \
    key-positions = <KEYPOS>; \
};

#define COMBOS_TOP_ROW(LTPR, LTRM, LTMI, RTIM, RTMR, RTRP) \
	SLOWCOMBO(_ltpr, LTPR, LM4 LM3) \
	COMBO(_ltrm, LTRM, LM3 LM2) \
	COMBO(_ltmi, LTMI, LM2 LM1) \
	COMBO(_rtim, RTIM, RM1 RM2) \
	COMBO(_rtmr, RTMR, RM2 RM3) \
	SLOWCOMBO(_rtrp, RTRP, RM3 RM4)
#define COMBOS_BOT_ROW(LBRM, LBMI, RBIM, RBMR) \
	COMBO(_lbrm, LBRM, LB3 LB2) \
	COMBO(_lbmi, LBMI, LB2 LB1) \
	COMBO(_rbim, RBIM, RB1 RB2) \
	COMBO(_rbmr, RBMR, RB2 RB3)

/* Homerow mods */
#define KEYS_L LM1 LM2 LM3 LM4 LB1 LB2 LB3
#define KEYS_R RM1 RM2 RM3 RM4 RB1 RB2 RB3
#define THUMBS LH1 LH0 RH0 RH1

#define MAKE_HRM(NAME, HOLD, TAP, TRIGGER_POS)                                 \
  ZMK_HOLD_TAP(NAME, bindings = <HOLD>, <TAP>; flavor = "balanced";            \
               tapping-term-ms = <230>; quick-tap-ms = <QUICK_TAP_MS>;         \
               require-prior-idle-ms = <150>; hold-trigger-on-release;         \
               hold-trigger-key-positions = <TRIGGER_POS>;)

MAKE_HRM(hl, &kp, &kp, KEYS_R THUMBS) // Left-hand HRMs.
MAKE_HRM(hr, &kp, &kp, KEYS_L THUMBS) // Right-hand HRMS.

//  _______________________  _______________________
// |  0  |  1  |  2  |  3  \/   4 |   5 |   6 |   7 |
//       \  8  |  9  | 10  /\  11 |  12 |  13 /
//             \ 14  | 15 /  \ 16 |  17 /
//              ----------    ----------

/{
    combos {
        compatible = "zmk,combos";
/* alphas */
                     //  LM4+LM3  LM3+LM2  LM2+LM1  RM1+RM2  RM2+RM3  RM3+RM4
        COMBOS_TOP_ROW(&kp W, &kp M, &kp B, &kp V, &comsem, &dotcol)
               COMBOS_BOT_ROW(&kp F, &kp P, &kp X, &kp Z)
                            //  LB3+LB2  LB2+LB1  RB1+RB2  RB2+RB3

/* usually on base layer */
        COMBO(q, &kp Q, LB3 LB1)
        COMBO(k, &kp K, LM2 LB1)
        COMBO(j, &kp J, RM2 RB1)
        COMBO(enter, &kp ENTER, RB1 RB3)
        COMBO(esc, &kp ESC, LM4 LM1)
        COMBO(semi, &kp SEMICOLON, RB2 RH0)
        COMBO(colon, &kp COLON, RB3 RH0)
        COMBO(minus, &kp MINUS, LM3 LB2)
        COMBO(slash, &kp SLASH, RM3 RB2)
/* parentheticals */
        COMBO(lt, &kp LT, LM3 LB1)
        COMBO(lbrc, &kp LBRC, LM3 LB3)
        COMBO(lbkt, &kp LBKT, LM2 LB2)
        COMBO(lpar, &kp LPAR, LM1 LB1)
        COMBO(rt, &kp GT, RM3 RB1)
        COMBO(rpar, &kp RPAR, RM1 RB1)
        COMBO(rbkt, &kp RBKT, RM2 RB2)
        COMBO(rbrc, &kp RBRC, RM3 RB3)
/* caps */
        COMBO(caps, &caps_word, LM1 RM1)
        COMBO(capslock, &kp CAPSLOCK, LM3 RM3)
/* deletion */
        COMBO(bspc, &kp BSPC, RM1 RM3)
        SLOWCOMBO(del, &kp DEL, RM2 RM4)
        COMBO(delword, &kp LC(BSPC), RM1 RM4)
    };
};


/ {
    behaviors {
        my_lt: my_layer_taps {
            compatible = "zmk,behavior-hold-tap";
            #binding-cells = <2>;
            flavor = "tap-preferred";
            tapping-term-ms = <160>;
            quick-tap-ms = <100>;
            bindings = <&mo &kp>, <&kp>;
        };
        dotcol: dot_colon {
            compatible = "zmk,behavior-mod-morph";
            #binding-cells = <0>;
            bindings = <&kp DOT>, <&kp COLON>;
            mods = <(MOD_LSFT|MOD_RSFT)>;
        };
        comsem: comma_semicolon {
            compatible = "zmk,behavior-mod-morph";
            #binding-cells = <0>;
            bindings = <&kp COMMA>, <&kp SEMI>;
            mods = <(MOD_LSFT|MOD_RSFT)>;
        };
    };
};


ZMK_BASE_LAYER(aptmak,
//╭─────────────┬─────────────┬─────────────┬─────────────╮   ╭─────────────┬─────────────┬─────────────┬─────────────╮
   &hl LCTRL R    &hl LALT S    &hl LGUI T    &hl LSHFT H ,     &hr RSHFT N   &hr RGUI A    &hr LALT I    &hr RCTRL O ,
//╰─────────────┼─────────────┼─────────────┼─────────────┤   ├─────────────┼─────────────┼─────────────┼─────────────╯
                  &kp C         &kp G         &kp D       ,     &kp L         &kp U         &kp Y       ,
//              ╰─────────────┼─────────────┼─────────────┤   ├─────────────┼─────────────┼─────────────╯
                           &my_lt NUM SQT &my_lt NAV SPACE,     &my_lt SYM E  &my_lt FUN TAB
//                            ╰─────────────┴─────────────╯   ╰─────────────┴─────────────╯
)

ZMK_BASE_LAYER(numbers,
//╭─────────────┬─────────────┬─────────────┬─────────────╮   ╭─────────────┬─────────────┬─────────────┬─────────────╮
   &hl LCTRL PLUS &hl LALT MINUS &hl LGUI STAR &hl LSHFT SLASH, &kp N4        &kp N5        &kp N6        &dotcol     ,
//╰─────────────┼─────────────┼─────────────┼─────────────┤   ├─────────────┼─────────────┼─────────────┼─────────────╯
                  &kp N9        &kp N8        &kp N7      ,     &kp N1        &kp N2        &kp N3      ,
//              ╰─────────────┼─────────────┼─────────────┤   ├─────────────┼─────────────┼─────────────╯
                                &trans        &trans      ,     &kp E         &kp N0
//                            ╰─────────────┴─────────────╯   ╰─────────────┴─────────────╯
)

ZMK_BASE_LAYER(navigation,
//╭─────────────┬─────────────┬─────────────┬─────────────╮   ╭─────────────┬─────────────┬─────────────┬─────────────╮
   &sk LCTRL      &sk LALT      &sk LGUI      &sk LSHFT   ,     &kp LEFT      &kp DOWN      &kp UP        &kp RIGHT   ,
//╰─────────────┼─────────────┼─────────────┼─────────────┤   ├─────────────┼─────────────┼─────────────┼─────────────╯
                  &kp C_AC_COPY &kp C_AC_CUT  &kp C_AC_PASTE,   &kp HOME      &kp C_MUTE    &kp END     ,
//              ╰─────────────┼─────────────┼─────────────┤   ├─────────────┼─────────────┼─────────────╯
                                &trans        &trans      ,     &kp C_VOL_DN  &kp C_VOL_UP
//                            ╰─────────────┴─────────────╯   ╰─────────────┴─────────────╯
)

ZMK_BASE_LAYER(symbols,
//╭─────────────┬─────────────┬─────────────┬─────────────╮   ╭─────────────┬─────────────┬─────────────┬─────────────╮
   &kp EXCL       &kp AT        &kp HASH      &kp DOLLAR  ,     &kp AMPERSAND &kp ASTERISK  &kp PERCENT   &kp CARET   ,
//╰─────────────┼─────────────┼─────────────┼─────────────┤   ├─────────────┼─────────────┼─────────────┼─────────────╯
                  &kp GRAVE     &kp DQT       &kp UNDERSCORE,   &kp BACKSLASH &kp PIPE      &kp EQUAL   ,
//              ╰─────────────┼─────────────┼─────────────┤   ├─────────────┼─────────────┼─────────────╯
                                &kp TILDE     &trans      ,     &trans        &trans
//                            ╰─────────────┴─────────────╯   ╰─────────────┴─────────────╯
)

ZMK_BASE_LAYER(function,
//╭─────────────┬─────────────┬─────────────┬─────────────╮   ╭─────────────┬─────────────┬─────────────┬─────────────╮
   &bootloader    &kp F12       &kp F11       &kp F10     ,     &kp F4        &kp F5        &kp F6        &none       ,
//╰─────────────┼─────────────┼─────────────┼─────────────┤   ├─────────────┼─────────────┼─────────────┼─────────────╯
                  &kp F9        &kp F8        &kp F7      ,     &kp F1        &kp F2        &kp F3      ,
//              ╰─────────────┼─────────────┼─────────────┤   ├─────────────┼─────────────┼─────────────╯
                                &trans        &trans      ,     &trans        &trans
//                            ╰─────────────┴─────────────╯   ╰─────────────┴─────────────╯
)
