#define ZMK_BASE_LAYER(name, LM, RM, LB, RB, LH, RH)                     \
    ZMK_LAYER(                                                           \
        name,                                                            \
                 LM RM                                                   \
                 LB RB                                                   \
                 LH RH                                                   \
    )

#include "key-labels/teenspirit.h"
#include "layouts/buggy.keymap"

