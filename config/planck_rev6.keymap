#define ZMK_BASE_LAYER(name, LT, RT, LM, RM, LB, RB, LH, RH)                   \
    ZMK_LAYER(                                                                 \
        name,                                                                  \
                             LT &none &none RT                                 \
                             LM &none &none RM                                 \
                             LB &none &none RB                                 \
        &none &none &kp LGUI LH &none &none RH &smart_mouse U_WH_D U_WH_U      \
    )

#include "zmk-helpers/key-labels/4x12_wide.h"
#include "layouts/urobbase.keymap"
